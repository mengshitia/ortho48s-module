// Physical layout.
/ {
  physical_layout0: physical_layout0 {
    compatible = "zmk,physical-layout";
    display-name = "Default Layout";
    // Label of the kscan node,
    // optional if all layouts use the same.
    kscan = <&kscan0>;
    // Label of the matrix transform for this layout.
    transform = <&default_transform>;
  };
};
