## boards/shields/ortho48s/Kconfig.defconfig
```kconfig
# Kconfig.defconfig

if SHIELD_MY_KEYBOARD_LEFT
  # For a split keyboard,
  # the keyboard name is assigned to the central,
  # the peripheral side is not assigned a name.
  # Name should less than 16 characters.
  config ZMK_KEYBOARD_NAME
    default "Ortho48s"

  # Set the split central.
  config ZMK_SPLIT_ROLE_CENTRAL
    default y

  # Enable fetching peripheral's batter level.
  config ZMK_SPLIT_BLE_CENTRAL_BATTERY_LEVEL_FETCHING
    default y
  config ZMK_SPLIT_BLE_CENTRAL_BATTERY_LEVEL_PROXY
    default y

endif

# The split config needs to be set for both sides.
if SHIELD_MY_KEYBOARD_LEFT || SHIELD_MY_KEYBOARD_RIGHT
  config ZMK_SPLIT
    default y

  # Enable NKRO:
  config ZMK_HID_REPORT_TYPE_NKRO
    default y

  # Idle and sleep timeout, in milliseconds.
  config ZMK_IDLE_TIMEOUT
    default 60000 # 60s
  config ZMK_SLEEP
    default y
  config ZMK_IDLE_SLEEP_TIMEOUT
    default 900000 # 900s(15min)

  # Enable soft off from keymap.
  config ZMK_PM_SOFT_OFF
    default y

  # Battery status on display(display must be available).
  config ZMK_WIDGET_BATTERY_STATUS
    default y
  config ZMK_WIDGET_BATTERY_STATUS_SHOW_PERCENTAGE
    default y
endif
```

## boards/shields/ortho48s/Kconfig.shield
```kconfig
# This is a split keyboard contains two halves,
# the names should be 'my_name_left' and 'my_name_right'.
# No whitespaces after the comma or in the name of keyboard.
config SHIELD_MY_KEYBOARD_LEFT
  def_bool $(shields_list_contains,ortho48s_left)

config SHIELD_MY_KEYBOARD_RIGHT
  def_bool $(shields_list_contains,ortho48s_right)
```

## boards/shields/ortho48s_r/Kconfig.defconfig
```kconfig
if SHIELD_MY_KEYBOARD

# Name should less than 16 characters.
  config ZMK_KEYBOARD_NAME
    default "Ortho48s R"

endif
```

## boards/shields/ortho48s_r/Kconfig.shield
```kconfig
# No whitespaces after the comma and in the keyboard name.
config SHIELD_MY_KEYBOARD
  def_bool $(shields_list_contains,ortho48s_r)
```

## boards/shields/ortho48slefthalf/Kconfig.defconfig
```kconfig
if SHIELD_ORTHO48SLEFTHALF
  config ZMK_KEYBOARD_NAME
    default "Ortho48s Left"

endif
```

## boards/shields/ortho48slefthalf/Kconfig.shield
```kconfig
config SHIELD_ORTHO48SLEFTHALF
  def_bool $(shields_list_contains,ortho48slefthalf)
```

## boards/shields/ortho48srighthalf/Kconfig.defconfig
```kconfig
if SHIELD_ORTHO48SRIGHTHALF
  config ZMK_KEYBOARD_NAME
    default "Ortho48s Right"

endif
```

## boards/shields/ortho48srighthalf/Kconfig.shield
```kconfig
config SHIELD_ORTHO48SRIGHTHALF
  def_bool $(shields_list_contains,ortho48srighthalf)
```
