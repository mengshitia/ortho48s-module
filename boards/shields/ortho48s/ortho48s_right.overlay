// Shield overlay of the right half.
#include "ortho48s.dtsi"

// kscan
&kscan0 {
  row-gpios =
    <&pro_micro 4 GPIO_ACTIVE_HIGH>
    ,<&pro_micro 5 GPIO_ACTIVE_HIGH>
    ,<&pro_micro 6 GPIO_ACTIVE_HIGH>
    ,<&pro_micro 7 GPIO_ACTIVE_HIGH>
  ;

  col-gpios =
    <&pro_micro 8 (GPIO_ACTIVE_HIGH | GPIO_PULL_DOWN)>
    ,<&pro_micro 9 (GPIO_ACTIVE_HIGH | GPIO_PULL_DOWN)>
    ,<&pro_micro 16 (GPIO_ACTIVE_HIGH | GPIO_PULL_DOWN)>
    ,<&pro_micro 10 (GPIO_ACTIVE_HIGH | GPIO_PULL_DOWN)>
    ,<&pro_micro 14 (GPIO_ACTIVE_HIGH | GPIO_PULL_DOWN)>
    ,<&pro_micro 15 (GPIO_ACTIVE_HIGH | GPIO_PULL_DOWN)>
  ;
};

// Transform offset,
// because the left half has 6 columns.
&default_transform {
  col-offset = <3>;
};
